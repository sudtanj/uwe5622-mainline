## unisocwcn/Kconfig
```kconfig
#
# UNISOC WCN device configuration (UWE5622 over SDIO, Allwinner boards)
#
menu "UNISOC WCN Device Drivers"

config WCN_BSP_DRIVER_BUILDIN
	bool "buildin bsp driver for unisoc chip"
	default n
	help
	  Build the WCN BSP driver into the kernel instead of as a module.

config AW_WIFI_DEVICE_UWE5622
	bool "allwinner board Support for uwe5622"
	default n
	help
	  This is support wcn chip for allwinner board.
	  if you want to support allwinner board.
	  please say "y".
	  Thanks.

config AW_BIND_VERIFY
	bool "allwinner wcn bind verify"
	depends on AW_WIFI_DEVICE_UWE5622
	default n
	help
	  This is support wcn bind verify for allwinner board.
	  if you want to do wcn chip bind verify.
	  please say "y".
	  Thanks.

endmenu
```
